## tools/qa/tests/cases/tree/drivers/thunderbolt/Kconfig
```kconfig
menuconfig USB4
	tristate "Unified support for USB4 and Thunderbolt"
	help
	  The fixture subsystem.

config USB4_DEBUGFS_WRITE
	bool "Enable write by debugfs"
	depends on USB4
```
